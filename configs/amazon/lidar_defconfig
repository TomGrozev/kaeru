## configs/amazon/lidar_defconfig
```kconfig
CONFIG_AMAZON_LIDAR=y
CONFIG_MEDIATEK_MT8167=y
CONFIG_APP_ADDRESS=0x41E1C75C
CONFIG_BOOTLOADER_BASE=0x41E00000
CONFIG_BOOTLOADER_PARTITION_NAME="expdb"
CONFIG_BOOTLOADER_SIZE=0x33D38
CONFIG_BOOTMODE_ADDRESS=0x41E3926C
CONFIG_DPRINTF_ADDRESS=0x41E1E820
CONFIG_FASTBOOT_FAIL_ADDRESS=0x41E1CDF0
CONFIG_FASTBOOT_FETCH_COMMAND=y
CONFIG_FASTBOOT_GETVAR_ADDRESS=0x41E1D678
CONFIG_FASTBOOT_INFO_ADDRESS=0x41E1CDB4
CONFIG_FASTBOOT_OKAY_ADDRESS=0x41E1CF9C
CONFIG_FASTBOOT_PUBLISH_ADDRESS=0x41E1CC4C
CONFIG_FASTBOOT_REGISTER_ADDRESS=0x41E1CBBC
CONFIG_FASTBOOT_USB_WRITE_ADDRESS=0x41E1CCFC
CONFIG_FREE_ADDRESS=0x41E1EAF0
CONFIG_INIT_STORAGE_ADDRESS=0x41E17B1C
CONFIG_INIT_STORAGE_CALLER=0x41E0F940
CONFIG_LK_LOG_STORE=n
CONFIG_LK_SIGNATURE_SIZE=0x104
CONFIG_MALLOC_ADDRESS=0x41E1F20C
CONFIG_MTK_DETECT_KEY_ADDRESS=0x41E11734
CONFIG_MT_PART_GET_DEVICE_ADDRESS=0x41E18E84
CONFIG_MT_PART_GET_PARTITION_ADDRESS=0x41E138C8
CONFIG_PLATFORM_INIT_ADDRESS=0x41E0F908
CONFIG_PLATFORM_INIT_CALLER=0x41E19EE2
CONFIG_STORAGE_SUPPORT=y
CONFIG_THREAD_CREATE_ADDRESS=0x41E1A0C0
CONFIG_THREAD_RESUME_ADDRESS=0x41E1A244
CONFIG_THREAD_SUPPORT=y
CONFIG_USE_MT_PART_API=y
CONFIG_VIDEO_PRINTF_ADDRESS=0x41E1EE1C
```
